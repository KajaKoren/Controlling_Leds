## src/modules/led/Kconfig.led
```kconfig
#
# Copyright (c) 2023 Nordic Semiconductor
#
# SPDX-License-Identifier: LicenseRef-Nordic-5-Clause
#

menuconfig MQTT_SAMPLE_LED
	bool "LED"
	select LED
	default y if !BOARD_NATIVE_POSIX

if MQTT_SAMPLE_LED

module = MQTT_SAMPLE_LED
module-str = LED
source "subsys/logging/Kconfig.template.log_config"

config TURN_LED_ON_CMD
	string "Command to turn on LED"
	default "LED1ON"

config TURN_LED_OFF_CMD
	string "Command to turn off LED"
	default "LED1OFF"

# # config MQTT_PAYLOAD_BUFFER_SIZE
# 	int "MQTT payload buffer size"
# 	default 128

endif # MQTT_SAMPLE_LED
```
